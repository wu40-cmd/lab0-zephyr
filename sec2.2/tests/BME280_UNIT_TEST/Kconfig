## sec2.2/tests/BME280_UNIT_TEST/testcase.yaml
```yaml
tests:
  bme280.logic:
    platform_allow:
      - qemu_cortex_m3
    tags:
      - bme280
      - unit
    harness: ztest
```

## sec2.2/tests/SUM_UNIT_TEST/testcase.yaml
```yaml
tests:
  sum_log.test:
    platform_allow:
      - qemu_cortex_m3
      - nrf7002dk_nrf5340_cpuapp_ns
    tags:
      - sum
      - unit
    harness: ztest
```
